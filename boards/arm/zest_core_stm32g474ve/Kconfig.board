## boards/arm/zest_core_stm32g474ve/Kconfig.board
```kconfig
# Zest Core STM32G474VE board configuration
# Copyright (c) 2023 CATIE
# SPDX-License-Identifier: Apache-2.0

config BOARD_ZEST_CORE_STM32G474VE
	bool "Zest Core STM32G474VE Development Board"
	depends on SOC_STM32G474XX
```

## boards/arm/zest_core_stm32g474ve/Kconfig.defconfig
```kconfig
# Zest Core STM32G474VE board configuration

# Copyright (c) 2023 CATIE
# SPDX-License-Identifier: Apache-2.0

if BOARD_ZEST_CORE_STM32G474VE

config BOARD
	default "zest_core_stm32g474ve"

endif # BOARD_ZEST_CORE_STM32G474VE
```

## boards/catie/zest_core_stm32g474ve/Kconfig.zest_core_stm32g474ve
```kconfig
# Copyright (c) 2023 CATIE
# SPDX-License-Identifier: Apache-2.0

config BOARD_ZEST_CORE_STM32G474VE
	select SOC_STM32G474XX
```
